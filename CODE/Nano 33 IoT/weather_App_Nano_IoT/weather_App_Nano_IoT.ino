/*
  Weather Monitor

  This example creates a Bluetooth® Low Energy peripheral with the weather service and
  level characteristic. 
  
  This example code is in the public domain.

  Written by Gustavo Reynaga @gsreynaga.

  For:  Nano 33 BLE

  ###########################################

  The Service and characteristic UUID are generated by  https://www.uuidgenerator.net/

  Weather service:            19B10010-E8F2-537E-4F6C-D104768A1214
  Temperature characteristic: 19B10011-E8F2-537E-4F6C-D104768A1214
  Humidity characteristic:    19B10012-E8F2-537E-4F6C-D104768A1214

*/

//Set BLE library

#include <ArduinoBLE.h>

#include "DHT.h"
#define DHTPIN 2
#define DHTTYPE DHT11

int pinLed = LED_BUILTIN;

 // Bluetooth® Low Energy Weather Service
BLEService TEMPHUMI("19B10010-E8F2-537E-4F6C-D104768A1214"); // BLE Service Temperature & Humidity

// BLE Temperature & Humidity Characteristic - custom 128-bit UUID, read by central
//BLEFloatCharacteristic 
BLEIntCharacteristic DHT11_TEMP( "19B10011-E8F2-537E-4F6C-D104768A1214", BLERead | BLENotify);
BLEIntCharacteristic DHT11_HUMI( "19B10012-E8F2-537E-4F6C-D104768A1214", BLERead | BLENotify);


long previousMillis = 0; // will store last time "Weather data" was updated

//float send_data_temp;
//float send_data_humi;
int send_data_temp;
int send_data_humi;

// DHT11
DHT dht(DHTPIN, DHTTYPE);

void setup() {
  Serial.begin(9600);    // initialize serial communication
  pinMode(pinLed, OUTPUT);
  // begin initialization
  if (!BLE.begin()) {
    Serial.println("starting BLE failed!");

    while (1);
  }
  dht.begin();

  // set advertised local name and service UUID:  
  BLE.setLocalName("NanoIoT_Weather");
  BLE.setAdvertisedService(TEMPHUMI);
  // add the characteristic to the service  
  TEMPHUMI.addCharacteristic(DHT11_TEMP);
  TEMPHUMI.addCharacteristic(DHT11_HUMI);
  // add service
  BLE.addService(TEMPHUMI);

  // begin advertising BLE service:
  BLE.advertise();

  Serial.println("BLE service start.");
 
}

void loop() {
  // listen for BLE peripherals to connect:
  BLEDevice central = BLE.central();
  
  // if a central is connected to peripheral:
  if (central) {
    Serial.print("Connected... ");
    digitalWrite(pinLed, HIGH);
    // print the central's MAC address:
    Serial.println(central.address());    
    

  // while the central is still connected to peripheral:
    while (central.connected()) {
      long currentMillis = millis();
      // if 5000ms have passed, check the Weather sensor:
      if (currentMillis - previousMillis >= 5000) {
        // save the last time "Weather data" was updated
        previousMillis = currentMillis;
        updateTemp();
        
      }
    }
    // when the central disconnects, print it out:
    Serial.print(F("Disconnected from central: "));
    digitalWrite(pinLed, LOW);
    Serial.println(central.address());
  }

}

void updateTemp(){
  // Read temperature as Celsius (the default) & Humidity
  float h = dht.readHumidity();  
  float t = dht.readTemperature();
  // Check if any reads failed and exit early (to try again).
  if (isnan(h) || isnan(t)) {
    Serial.println(F("Failed to read from DHT sensor!"));
    return;
  }
  int temp = round(t);
  send_data_temp = temp; //send temperature  
  DHT11_TEMP.setValue(send_data_temp);
  int humi = round(h);
  send_data_humi = humi;//send humidity  
  DHT11_HUMI.setValue(send_data_humi);
  
  //send Weather data to serial monitor (only for debug)  
  Serial.print("Temperature: ");
  Serial.print(t);
  Serial.println(F("°C "));
  Serial.print("Humidity: ");
  Serial.print(h);
  Serial.println(F("% "));

}

